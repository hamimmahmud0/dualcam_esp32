## main/Kconfig.projbuild
```kconfig
menu "MasterCam"

config MASTER_ID
    string "Master device ID (6 hex digits)"
    default "000000"

config SLAVE_ID
    string "Slave device ID (6 hex digits)"
    default "000000"

config APP_ROLE_SLAVE
    bool "Build slave firmware"
    default n
    help
        Enable to build the slave application (UDP sync responder + streaming).

config APP_ROLE_CAPTURE_ONLY
    bool "Build capture-only firmware"
    default n
    help
        Enable to build the capture-only application (no Wi-Fi/mDNS/web server).
        This formats the SD card at boot and runs a local capture sequence.

config APP_ROLE_CAPTURE_ONLY_QVGA
    bool "Build capture-only firmware (QVGA)"
    default n
    help
        Enable to build the capture-only QVGA application (no Wi-Fi/mDNS/web server).
        This formats the SD card at boot and runs a local capture sequence.

config APP_ROLE_UDP_RGB565
    bool "Build UDP RGB565 streaming firmware"
    default n
    help
        Enable to build the UDP RGB565 streaming application (Wi-Fi + mDNS only).
        Streams VGA RGB565 frames over UDP when a client sends START to port 55.

config ENABLE_LOGGING
    bool "Enable logging"
    default y
    help
        Enable ESP_LOG* output. Disable to reduce log noise and overhead.

config CAPTURE_FLUSH_EVERY_N_FRAMES
    int "Flush eMMC every N frames (0 to disable)"
    default 1
    range 0 1000
    help
        Flush and fsync the capture file every N frames to reduce data loss risk.
        Set to 0 to disable periodic flushes for higher throughput.

config CAPTURE_MANUAL_EXPOSURE
    bool "Capture-only: manual exposure (disable AEC)"
    default n
    help
        Disable auto-exposure and use a fixed exposure value for capture-only modes.

config CAPTURE_MANUAL_EXPOSURE_VALUE
    int "Capture-only: manual exposure value (AEC units)"
    default 200
    range 0 1200
    depends on CAPTURE_MANUAL_EXPOSURE
    help
        Manual exposure value for OV3660 (units of 1/16 line). Smaller = shorter shutter.

config CAPTURE_PCLK_HZ
    int "Capture-only: sensor PCLK (Hz)"
    default 10000000
    range 1000000 50000000
    help
        Pixel clock used to estimate shutter time from AEC value and HTS.
        Read it from the OV3660 log (PCLK) after init.

config WIFI_SSID
    string "WiFi SSID"
    default ""

config WIFI_PASSWORD
    string "WiFi Password"
    default ""

config CAPSEQ_SLAVE_PREPARE_DELAY_MS
    int "Slave prepare delay (ms)"
    default 3000

config CAPSEQ_DROP_FRAMES
    int "Drop frames to stabilize"
    default 5

config CAPSEQ_SYNC_SAFETY_MS
    int "Sync safety overhead (ms)"
    default 1000

config CAPSEQ_SYNC_UDP_PINGS
    int "UDP sync ping count"
    default 5

config CAPSEQ_SYNC_UDP_PORT
    int "UDP sync port"
    default 65

config CAPSEQ_SLAVE_READY_TIMEOUT_MS
    int "Slave UDP ready timeout (ms)"
    default 5000

config CAPSEQ_SLAVE_READY_POLL_MS
    int "Slave UDP ready poll interval (ms)"
    default 200

config CAPSEQ_SYNC_START_RETRIES
    int "UDP start retries"
    default 3

config CAPSEQ_SYNC_START_RETRY_DELAY_MS
    int "UDP start retry delay (ms)"
    default 100

config CAPSEQ_ALLOW_SLAVE_MISSING
    bool "Allow capture if slave not available"
    default y

endmenu
```

## psram_diag/sdkconfig.defaults
```kconfig
CONFIG_ESPTOOLPY_FLASHMODE_DIO=y
CONFIG_ESPTOOLPY_FLASHFREQ_80M=y
CONFIG_ESPTOOLPY_FLASHSIZE_4MB=y
CONFIG_SPIRAM=y
CONFIG_SPIRAM_MODE_QUAD=y
CONFIG_SPIRAM_TYPE_AUTO=y
CONFIG_SPIRAM_SPEED_40M=y
CONFIG_SPIRAM_BOOT_INIT=y
CONFIG_SPIRAM_USE_MALLOC=y
CONFIG_SPIRAM_MEMTEST=y
CONFIG_SPIRAM_TRY_ALLOCATE_WIFI_LWIP=n
CONFIG_SPIRAM_CACHE_WORKAROUND=y
CONFIG_SPIRAM_CACHE_WORKAROUND_STRATEGY_MEMW=y
# CONFIG_SPIRAM_BANKSWITCH_ENABLE is not set
# CONFIG_SPIRAM_OCCUPY_VSPI_HOST is not set
CONFIG_SPIRAM_2T_MODE=y
CONFIG_D0WD_PSRAM_CLK_IO=17
CONFIG_D0WD_PSRAM_CS_IO=16
CONFIG_D2WD_PSRAM_CLK_IO=9
CONFIG_D2WD_PSRAM_CS_IO=10
CONFIG_PICO_PSRAM_CS_IO=10
CONFIG_SPIRAM_SPIWP_SD3_PIN=7
CONFIG_ESP_MAIN_TASK_STACK_SIZE=4096
```
